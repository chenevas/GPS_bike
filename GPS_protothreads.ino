// GNSS: Red->5V, Black->GND, TX Green->3, RX Yellow->5
// Screen: Red->3.3V, Brown->GND, Orange->SCL, Yellow->SDA 

#include <pt.h>
#include <SPI.h>
#include <Wire.h>
//#include <Adafruit_GFX.h>
//#include <Adafruit_SSD1306.h>

#include "SSD1306Ascii.h"
#include "SSD1306AsciiWire.h"

#include <SoftwareSerial.h>
#include "SdFat.h"
SdFat SD;
//#include <SD.h>

////// SD
File myFile;
const int PROGMEM pinCS = 10; // Pin 10 on Arduino Uno

// pt test
static struct pt ptDisp, ptGNSS;

////////////////////////////////////////////////////////////////////////////// GNSS ///////////////////////////////////////////////////////////////////////////////////

SoftwareSerial serial = SoftwareSerial(3,5);

const char UBLOX_INIT[] PROGMEM = {
  // Disable NMEA
  0xB5,0x62,0x06,0x01,0x08,0x00,0xF0,0x00,0x00,0x00,0x00,0x00,0x00,0x01,0x00,0x24, // GxGGA off
  0xB5,0x62,0x06,0x01,0x08,0x00,0xF0,0x01,0x00,0x00,0x00,0x00,0x00,0x01,0x01,0x2B, // GxGLL off
  0xB5,0x62,0x06,0x01,0x08,0x00,0xF0,0x02,0x00,0x00,0x00,0x00,0x00,0x01,0x02,0x32, // GxGSA off
  0xB5,0x62,0x06,0x01,0x08,0x00,0xF0,0x03,0x00,0x00,0x00,0x00,0x00,0x01,0x03,0x39, // GxGSV off
  0xB5,0x62,0x06,0x01,0x08,0x00,0xF0,0x04,0x00,0x00,0x00,0x00,0x00,0x01,0x04,0x40, // GxRMC off
  0xB5,0x62,0x06,0x01,0x08,0x00,0xF0,0x05,0x00,0x00,0x00,0x00,0x00,0x01,0x05,0x47, // GxVTG off

  // Disable UBX
  0xB5,0x62,0x06,0x01,0x08,0x00,0x01,0x07,0x00,0x00,0x00,0x00,0x00,0x00,0x17,0xDC, //NAV-PVT off
  0xB5,0x62,0x06,0x01,0x08,0x00,0x01,0x02,0x00,0x00,0x00,0x00,0x00,0x00,0x12,0xB9, //NAV-POSLLH off
  0xB5,0x62,0x06,0x01,0x08,0x00,0x01,0x03,0x00,0x00,0x00,0x00,0x00,0x00,0x13,0xC0, //NAV-STATUS off

  // Enable UBX
  0xB5,0x62,0x06,0x01,0x08,0x00,0x01,0x07,0x00,0x01,0x00,0x00,0x00,0x00,0x18,0xE1, //NAV-PVT on
  //0xB5,0x62,0x06,0x01,0x08,0x00,0x01,0x02,0x00,0x01,0x00,0x00,0x00,0x00,0x13,0xBE, //NAV-POSLLH on
  //0xB5,0x62,0x06,0x01,0x08,0x00,0x01,0x03,0x00,0x01,0x00,0x00,0x00,0x00,0x14,0xC5, //NAV-STATUS on

  // Rate
  //0xB5,0x62,0x06,0x08,0x06,0x00,0x64,0x00,0x01,0x00,0x01,0x00,0x7A,0x12, //(10Hz)
  //0xB5,0x62,0x06,0x08,0x06,0x00,0xC8,0x00,0x01,0x00,0x01,0x00,0xDE,0x6A, //(5Hz)
  0xB5,0x62,0x06,0x08,0x06,0x00,0xE8,0x03,0x01,0x00,0x01,0x00,0x01,0x39, //(1Hz)
};

const unsigned char UBX_HEADER[] = { 0xB5, 0x62 };

struct NAV_PVT {
  unsigned char cls;
  unsigned char id;
  unsigned short len;
  unsigned long iTOW;          // GPS time of week of the navigation epoch (ms)
  
  unsigned short year;         // Year (UTC) 
  unsigned char month;         // Month, range 1..12 (UTC)
  unsigned char day;           // Day of month, range 1..31 (UTC)
  unsigned char hour;          // Hour of day, range 0..23 (UTC)
  unsigned char minute;        // Minute of hour, range 0..59 (UTC)
  unsigned char second;        // Seconds of minute, range 0..60 (UTC)
  char valid;                  // Validity Flags (see graphic below)
  unsigned long tAcc;          // Time accuracy estimate (UTC) (ns)
  long nano;                   // Fraction of second, range -1e9 .. 1e9 (UTC) (ns)
  unsigned char fixType;       // GNSSfix Type, range 0..5
  char flags;                  // Fix Status Flags
  unsigned char reserved1;     // reserved
  unsigned char numSV;         // Number of satellites used in Nav Solution
  
  long lon;                    // Longitude (deg)
  long lat;                    // Latitude (deg)
  long height;                 // Height above Ellipsoid (mm)
  long hMSL;                   // Height above mean sea level (mm)
  unsigned long hAcc;          // Horizontal Accuracy Estimate (mm)
  unsigned long vAcc;          // Vertical Accuracy Estimate (mm)
  
  long velN;                   // NED north velocity (mm/s)
  long velE;                   // NED east velocity (mm/s)
  long velD;                   // NED down velocity (mm/s)
  long gSpeed;                 // Ground Speed (2-D) (mm/s)
  long heading;                // Heading of motion 2-D (deg)
  unsigned long sAcc;          // Speed Accuracy Estimate
  unsigned long headingAcc;    // Heading Accuracy Estimate
  unsigned short pDOP;         // Position dilution of precision
  short reserved2;             // Reserved
  unsigned long reserved3;     // Reserved
  unsigned char dummy[8];      // Dummy
};

NAV_PVT pvt;

void calcChecksum(unsigned char* CK) {
  memset(CK, 0, 2);
  for (int i = 0; i < (int)sizeof(NAV_PVT); i++) {
    CK[0] += ((unsigned char*)(&pvt))[i];
    CK[1] += CK[0];
  }
}

bool processGPS() {
  static int fpos = 0;
  static unsigned char checksum[2];
  const int payloadSize = sizeof(NAV_PVT);
  
  while ( serial.available() ) {
    byte c = serial.read();
    if ( fpos < 2 ) {
      if ( c == UBX_HEADER[fpos] )
        fpos++;
      else
        fpos = 0;
    }
    else {      
      if ( (fpos-2) < payloadSize )
        ((unsigned char*)(&pvt))[fpos-2] = c;

      fpos++;

      if ( fpos == (payloadSize+2) ) {
        calcChecksum(checksum);
      }
      else if ( fpos == (payloadSize+3) ) {
        if ( c != checksum[0] )
          fpos = 0;
      }
      else if ( fpos == (payloadSize+4) ) {
        fpos = 0;
        if ( c == checksum[1] ) {
          return true;
        }
      }
      else if ( fpos > (payloadSize+4) ) {
        fpos = 0;
      }
    }
  }
  return false;
}

////////////////////////////////////////////////////////////////////////////////// Screen /////////////////////////////////////////////////////////////////////////

#define SCREEN_WIDTH 128 // OLED display width, in pixels
#define SCREEN_HEIGHT 64 // OLED display height, in pixels
#define SPEED 300

//
//// Declaration for an SSD1306 display connected to I2C (SDA, SCL pins)
//#define OLED_RESET     -1 // Reset pin # (or -1 if sharing Arduino reset pin)
//Adafruit_SSD1306 display(SCREEN_WIDTH, SCREEN_HEIGHT, &Wire, OLED_RESET);

#define I2C_ADDRESS 0x3C

// Define proper RST_PIN if required.
#define RST_PIN -1

SSD1306AsciiWire oled;

const unsigned char PROGMEM velo1_56x48 []{
0x00, 0x00, 0x00, 0x00, 0x00, 0x00, 0x00, 0x00, 0x00, 0x00, 0x00, 0x00, 0x00, 0x00, 0x00, 0x00, 
0x00, 0x00, 0x00, 0x00, 0x00, 0x00, 0x00, 0x00, 0x00, 0x00, 0x00, 0x00, 0x00, 0x00, 0x00, 0x00, 
0x00, 0x00, 0x00, 0x00, 0xbc, 0xfe, 0xe7, 0xc3, 0xc3, 0xe7, 0x7e, 0x3c, 0x00, 0x00, 0x00, 0x00, 
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0x20, 0x40, 0x40, 0x80, 0x80, 0x80, 0x80, 0x80, 0x80, 0x80, 0x40, 0x40, 0x20, 0x10, 0x0c, 0x03};

const unsigned char PROGMEM velo2_56x48 []{
0x00, 0x00, 0x00, 0x00, 0x00, 0x00, 0x00, 0x00, 0x00, 0x00, 0x00, 0x00, 0x00, 0x00, 0x00, 0x00, 
0x00, 0x00, 0x00, 0x00, 0x00, 0x00, 0x00, 0x00, 0x00, 0x00, 0x00, 0x00, 0x00, 0x00, 0x00, 0x00, 
0x00, 0x00, 0x00, 0x00, 0xbc, 0xfe, 0xe7, 0xc3, 0xc3, 0xe7, 0x7e, 0x3c, 0x00, 0x00, 0x00, 0x00, 
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0x20, 0x40, 0x40, 0x80, 0x80, 0x80, 0x80, 0x80, 0x80, 0x80, 0x40, 0x40, 0x20, 0x10, 0x0c, 0x03
};

const unsigned char PROGMEM velo3_56x48 []{
0x00, 0x00, 0x00, 0x00, 0x00, 0x00, 0x00, 0x00, 0x00, 0x00, 0x00, 0x00, 0x00, 0x00, 0x00, 0x00, 
0x00, 0x00, 0x00, 0x00, 0x00, 0x00, 0x00, 0x00, 0x00, 0x00, 0x00, 0x00, 0x00, 0x00, 0x00, 0x00, 
0x00, 0x00, 0x00, 0x00, 0xbc, 0xfe, 0xe7, 0xc3, 0xc3, 0xe7, 0x7e, 0x3c, 0x00, 0x00, 0x00, 0x00, 
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0x20, 0x40, 0x40, 0x80, 0x80, 0x80, 0x80, 0x80, 0x80, 0x80, 0x40, 0x40, 0x20, 0x10, 0x0c, 0x03
};

const unsigned char PROGMEM velo4_56x48 []{
0x00, 0x00, 0x00, 0x00, 0x00, 0x00, 0x00, 0x00, 0x00, 0x00, 0x00, 0x00, 0x00, 0x00, 0x00, 0x00, 
0x00, 0x00, 0x00, 0x00, 0x00, 0x00, 0x00, 0x00, 0x00, 0x00, 0x00, 0x00, 0x00, 0x00, 0x00, 0x00, 
0x00, 0x00, 0x00, 0x00, 0xbc, 0xfe, 0xe7, 0xc3, 0xc3, 0xe7, 0x7e, 0x3c, 0x00, 0x00, 0x00, 0x00, 
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0x20, 0x40, 0x40, 0x80, 0x80, 0x80, 0x80, 0x80, 0x80, 0x80, 0x40, 0x40, 0x20, 0x10, 0x0c, 0x03
};

const unsigned char PROGMEM velo5_56x48 []{
0x00, 0x00, 0x00, 0x00, 0x00, 0x00, 0x00, 0x00, 0x00, 0x00, 0x00, 0x00, 0x00, 0x00, 0x00, 0x00, 
0x00, 0x00, 0x00, 0x00, 0x00, 0x00, 0x00, 0x00, 0x00, 0x00, 0x00, 0x00, 0x00, 0x00, 0x00, 0x00, 
0x00, 0x00, 0x00, 0x00, 0xbc, 0xfe, 0xe7, 0xc3, 0xc3, 0xe7, 0x7e, 0x3c, 0x00, 0x00, 0x00, 0x00, 
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0x20, 0x40, 0x40, 0x80, 0x80, 0x80, 0x80, 0x80, 0x80, 0x80, 0x40, 0x40, 0x20, 0x10, 0x0c, 0x03
};

const unsigned char PROGMEM velo6_56x48 []{
0x00, 0x00, 0x00, 0x00, 0x00, 0x00, 0x00, 0x00, 0x00, 0x00, 0x00, 0x00, 0x00, 0x00, 0x00, 0x00, 
0x00, 0x00, 0x00, 0x00, 0x00, 0x00, 0x00, 0x00, 0x00, 0x00, 0x00, 0x00, 0x00, 0x00, 0x00, 0x00, 
0x00, 0x00, 0x00, 0x00, 0xbc, 0xfe, 0xe7, 0xc3, 0xc3, 0xe7, 0x7e, 0x3c, 0x00, 0x00, 0x00, 0x00, 
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0x20, 0x40, 0x40, 0x80, 0x80, 0x80, 0x80, 0x80, 0x80, 0x80, 0x40, 0x40, 0x20, 0x10, 0x0c, 0x03
};

const unsigned char PROGMEM velo7_56x48 []{
0x00, 0x00, 0x00, 0x00, 0x00, 0x00, 0x00, 0x00, 0x00, 0x00, 0x00, 0x00, 0x00, 0x00, 0x00, 0x00, 
0x00, 0x00, 0x00, 0x00, 0x00, 0x00, 0x00, 0x00, 0x00, 0x00, 0x00, 0x00, 0x00, 0x00, 0x00, 0x00, 
0x00, 0x00, 0x00, 0x00, 0xbc, 0xfe, 0xe7, 0xc3, 0xc3, 0xe7, 0x7e, 0x3c, 0x00, 0x00, 0x00, 0x00, 
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0x20, 0x40, 0x40, 0x80, 0x80, 0x80, 0x80, 0x80, 0x80, 0x80, 0x40, 0x40, 0x20, 0x10, 0x0c, 0x03
};

const unsigned char PROGMEM velo8_56x48 []{
0x00, 0x00, 0x00, 0x00, 0x00, 0x00, 0x00, 0x00, 0x00, 0x00, 0x00, 0x00, 0x00, 0x00, 0x00, 0x00, 
0x00, 0x00, 0x00, 0x00, 0x00, 0x00, 0x00, 0x00, 0x00, 0x00, 0x00, 0x00, 0x00, 0x00, 0x00, 0x00, 
0x00, 0x00, 0x00, 0x00, 0xbc, 0xfe, 0xe7, 0xc3, 0xc3, 0xe7, 0x7e, 0x3c, 0x00, 0x00, 0x00, 0x00, 
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0x20, 0x40, 0x40, 0x80, 0x80, 0x80, 0x80, 0x80, 0x80, 0x80, 0x40, 0x40, 0x20, 0x10, 0x0c, 0x03
};

const unsigned char *const velo_table[] PROGMEM = {velo1_56x48, velo2_56x48, velo3_56x48, velo4_56x48, velo5_56x48, velo6_56x48, velo7_56x48, velo8_56x48};

void dispVelo(const unsigned char velo) {
  oled.clear();
      byte r = 0; // Start row
      byte c = 0 ; // Start col
      int a = 0; // Position in array - Don't change - an array larger than 256 will need to use "int = a"
      for (byte b = 0; b < 6; b++) { 
        oled.setCursor (c,(r+b)); 
        for (byte i = 0; i < 56; i++) { 
          oled.ssd1306WriteRam(pgm_read_byte(&velo8_56x48[a]));
          a++;
        }  
      }
      oled.setCursor (56,0);
      oled.print("lat/lon");
}

/////////////////////////////////////////////////////////////////////////////////////// Protothreads ///////////////////////////////////////////////////////////////////////////////////
static int protothreadDisplay(struct pt *pt)
{
  static unsigned long lastFrameTime = 0;
  PT_BEGIN(pt);
  while(1) {
    lastFrameTime = millis();
    PT_WAIT_UNTIL(pt, millis() - lastFrameTime > SPEED);
    dispVelo(&velo8_56x48);
    
//    for (static int i = 1; i <= 8; i++) {
//      lastFrameTime = millis();
//      PT_WAIT_UNTIL(pt, millis() - lastFrameTime > SPEED);
////      display.clearDisplay();
////      display.drawBitmap(0, 15, velo_table[i], 52, 50, SSD1306_WHITE);
////      display.display();
//      oled.clear();
//      byte r = 0; // Start row
//      byte c = 0 ; // Start col
//      int a = 0; // Position in array - Don't change - an array larger than 256 will need to use "int = a"
//      for (byte b = 0; b < 6; b++) { 
//        oled.setCursor (c,(r+b)); 
//        for (byte i = 0; i < 56; i++) { 
//          oled.ssd1306WriteRam(pgm_read_byte(&velo8_56x48[a]));
//          a++;
//        }  
//      }
//      oled.setCursor (56,0);
//      oled.print("lat/lon");
//    }
    
//    lastFrameTime = millis();
//    PT_WAIT_UNTIL(pt, millis() - lastFrameTime > SPEED);
//    display.clearDisplay();
//    display.drawBitmap(0, 15, velo1, 52, 50, SSD1306_WHITE);
//    display.display();
//    lastFrameTime = millis();
//    PT_WAIT_UNTIL(pt, millis() - lastFrameTime > SPEED);
//    display.clearDisplay();
//    display.drawBitmap(0, 15, velo2, 52, 50, SSD1306_WHITE);
//    display.display();
//    lastFrameTime = millis();
//    PT_WAIT_UNTIL(pt, millis() - lastFrameTime > SPEED);
//    display.clearDisplay();
//    display.drawBitmap(0, 15, velo3, 52, 50, SSD1306_WHITE);
//    display.display();
//    lastFrameTime = millis();
//    PT_WAIT_UNTIL(pt, millis() - lastFrameTime > SPEED);
//    display.clearDisplay();
//    display.drawBitmap(0, 15, velo4, 52, 50, SSD1306_WHITE);
//    display.display();
//    lastFrameTime = millis();
//    PT_WAIT_UNTIL(pt, millis() - lastFrameTime > SPEED);
//    display.clearDisplay();
//    display.drawBitmap(0, 15, velo5, 52, 50, SSD1306_WHITE);
//    display.display();
//    lastFrameTime = millis();
//    PT_WAIT_UNTIL(pt, millis() - lastFrameTime > SPEED);
//    display.clearDisplay();
//    display.drawBitmap(0, 15, velo6, 52, 50, SSD1306_WHITE);
//    display.display();
//    lastFrameTime = millis();
//    PT_WAIT_UNTIL(pt, millis() - lastFrameTime > SPEED);
//    display.clearDisplay();
//    display.drawBitmap(0, 15, velo7, 52, 50, SSD1306_WHITE);
//    display.display();
//    lastFrameTime = millis();
//    PT_WAIT_UNTIL(pt, millis() - lastFrameTime > SPEED);
//    display.clearDisplay();
//    display.drawBitmap(0, 15, velo8, 52, 50, SSD1306_WHITE);
//    display.display();
//    lastFrameTime = millis();
  }
  PT_END(pt);
}

int compteurSD = 0;

static int protothreadGNSS(struct pt *pt)
{
  static unsigned long lastGNSSTime = 0;
  PT_BEGIN(pt);
  while(1) {
    lastGNSSTime = millis();
    PT_WAIT_UNTIL(pt, processGPS());
    Serial.print(F("fixType: ")); Serial.print(pvt.fixType); Serial.print(F(", "));
    Serial.print(F("lat/lon:")); Serial.print(pvt.lat/10000000.0f,6); Serial.print(F(", ")); Serial.print(pvt.lon/10000000.0f,6);
//    Serial.print(" gSpeed: ");  Serial.print(pvt.gSpeed/1000.0f,2);
    Serial.println();
    if (pvt.fixType = 3){
        myFile.print(pvt.lat); myFile.print(F(", ")); myFile.println(pvt.lon);
      if (compteurSD > 8) {
        myFile.flush();
        compteurSD = 0;
      }
      else {
        compteurSD += 1;
      }
    }
  }
  PT_END(pt);
}

////////////////////////////////////////////////////////////////////////////////////// SETUP //////////////////////////////////////////////////////////////////////////////// 

void setup() {
  Serial.begin(9600);
  serial.begin(9600);
  delay(100);
  
  ////////// SD card ////////
  pinMode(pinCS, OUTPUT);
  
  // SD Card Initialization
  if (SD.begin())
  {
    Serial.println(F("SD card is ready to use."));
  } else
  {
    Serial.println(F("SD card initialization failed"));
    return;
  }
  
  // Create/Open file 
  myFile = SD.open("test.txt", FILE_WRITE);
  
  // if the file opened okay, write to it:
  if (myFile) {
    Serial.println(F("Opened file successfully"));
    // Write to file
    myFile.println(F("compteur, lat, lon"));
    myFile.flush(); // close the file
  }
  // if the file didn't open, print an error:
  else {
    Serial.println(F("error opening test.txt"));
  }
  
  ////////// Protothreads ////////
  PT_INIT(&ptDisp);
  PT_INIT(&ptGNSS);


  ////////// GNSS ////////
  // send configuration data in UBX protocol
  for(int i = 0; i < sizeof(UBLOX_INIT); i++) {                        
    serial.write( pgm_read_byte(UBLOX_INIT+i) );
    delay(5); // simulating a 38400baud pace (or less), otherwise commands are not accepted by the device.
  }
  
  ////////// Screen //////////
  Wire.begin();
  Wire.setClock(400000L);

  #if RST_PIN >= 0
    oled.begin(&Adafruit128x64, I2C_ADDRESS, RST_PIN);
  #else // RST_PIN >= 0
    oled.begin(&Adafruit128x64, I2C_ADDRESS);
  #endif // RST_PIN >= 0

  oled.setFont(System5x7);
  oled.clear();
  oled.print("Hello world!");

  delay(1000);
  oled.clear();
  
  // for a 128x32 image
  byte r = 0; // Start row
  byte c = 0 ; // Start col
  int a = 0; // Position in array - Don't change - an array larger than 256 will need to use "int = a"
  for (byte b = 0; b < 6; b++) { 
    oled.setCursor (c,(r+b)); 
    for (byte i = 0; i < 56; i++) { 
      oled.ssd1306WriteRam(pgm_read_byte(&velo8_56x48[a]));
      a++;
    }  
  }
  oled.setCursor (56,0);
  oled.print("lat/lon");
}


////////////////////////////////////////////////////////////////////////////////////// LOOP //////////////////////////////////////////////////////////////////////////////// 

void loop() {
  protothreadDisplay(&ptDisp);
  protothreadGNSS(&ptGNSS);
}
